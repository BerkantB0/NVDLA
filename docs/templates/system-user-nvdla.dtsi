/*
 * The XSA-generated node supplies reg, interrupts, and both clock references.
 */
&xilNvDlaWrapper_0 {
    compatible = "nvidia,nv_small";
    status = "okay";
    /*
     * Keep the coherent-DMA property absent for the current XSA. The DBB path
     * reaches DDR through S_AXI_HP0_FPD and the audited PS coherency flags are
     * off.
     */
};
